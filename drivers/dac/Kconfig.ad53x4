## drivers/dac/Kconfig.ad53x4
```kconfig
# DAC configuration options

# SPDX-FileCopyrightText: Copyright The Zephyr Project Contributors
# SPDX-License-Identifier: Apache-2.0

config DAC_AD53X4
	bool "Analog Devices AD53x4 DAC driver"
	default y
	select SPI
	depends on DT_HAS_ADI_AD5304_ENABLED \
		|| DT_HAS_ADI_AD5314_ENABLED \
		|| DT_HAS_ADI_AD5324_ENABLED
	help
	  Enable the driver for the Analog Devices AD53x4 DAC family.

if DAC_AD53X4

config DAC_AD53X4_INIT_PRIORITY
	int "Init priority"
	default 80
	help
	  Analog Devices AD53x4 DAC device driver initialization priority.

endif # DAC_AD53X4
```

## dts/bindings/dac/adi,ad5304.yaml
```yaml
# SPDX-FileCopyrightText: Copyright The Zephyr Project Contributors
# SPDX-License-Identifier: Apache-2.0

description: Analog Devices 8-bit, 4-channel SPI DAC

compatible: "adi,ad5304"

include: adi,ad53x4-base.yaml
```

## dts/bindings/dac/adi,ad5314.yaml
```yaml
# SPDX-FileCopyrightText: Copyright The Zephyr Project Contributors
# SPDX-License-Identifier: Apache-2.0

description: Analog Devices 10-bit, 4-channel SPI DAC

compatible: "adi,ad5314"

include: adi,ad53x4-base.yaml
```

## dts/bindings/dac/adi,ad5324.yaml
```yaml
# SPDX-FileCopyrightText: Copyright The Zephyr Project Contributors
# SPDX-License-Identifier: Apache-2.0

description: Analog Devices 12-bit, 4-channel SPI DAC

compatible: "adi,ad5324"

include: adi,ad53x4-base.yaml
```

## dts/bindings/dac/relmon,ms5314.yaml
```yaml
# SPDX-FileCopyrightText: Copyright The Zephyr Project Contributors
# SPDX-License-Identifier: Apache-2.0

description: |
  Relmon MS5314 10-bit, 4-channel SPI DAC.

  The published timing diagram shows the clock idle high and data sampled on
  the falling edge. Requiring spi-cpol is a conservative constraint based on
  that diagram; it does not assert that SPI mode 1 is incompatible.

  List "adi,ad5314" after this compatible to use the AD53x4 driver, as in:
    compatible = "relmon,ms5314", "adi,ad5314";

compatible: "relmon,ms5314"

include: adi,ad53x4-base.yaml

properties:
  spi-cpol:
    required: true
```
